/*
 * Device tree source for Samsung's Exynos4412-based T03G board (GT-N7100)
 *
 * Copyright (c) 2017 Simon Shields <simon@lineageos.org>
 *
 * This program is free software; you can redistribute it and/or modify
 * it under the terms of the GNU General Public License version 2 as
 * published by the Free Software Foundation
 */

/dts-v1/;
#include "exynos4412-t0.dtsi"

/ {
	compatible = "samsung,t03g", "samsung,t0", "samsung,midas", "samsung,exynos4412", "samsung,exynos4";

	// the only thing that will go here is modem configuration
	// and s-pen i2c configuration
};
