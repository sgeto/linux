// SPDX-License-Identifier: GPL-2.0
/dts-v1/;
#include "exynos4412-galaxy-s3.dtsi"

/ {
	model = "Samsung M3 (GT-I9305) based on Exynos4412";
	compatible = "samsung,m3", "samsung,midas", "samsung,exynos4412", "samsung,exynos4";

	memory@40000000 {
		device_type = "memory";
		reg =  <0x40000000 0x80000000>;
	};

};
