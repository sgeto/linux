## Documentation/devicetree/bindings/arm/samsung/exynos-chipid.txt
```
SAMSUNG Exynos SoCs Chipid driver.

Required properties:
- compatible : Should at least contain "samsung,exynos4210-chipid".

- reg: offset and length of the register set

Optional properties:
- clocks : Clock to ungate when kexec'ing to ensure chipid is active
- clock-names : Should be "chipid"

Example:
	chipid@10000000 {
		compatible = "samsung,exynos4210-chipid";
		reg = <0x10000000 0x100>;
		clocks = <&clock CLK_CHIPID>;
		clock-names = "chipid";
	};
```

## Documentation/devicetree/bindings/input/touchscreen/mms114.txt
```
* MELFAS MMS114/MMS152 touchscreen controller

Required properties:
- compatible: "melfas,mms114" for MMS114, or "melfas,mms152" for MMS152
- reg: I2C address of the chip
- interrupts: interrupt to which the chip is connected
- x-size: horizontal resolution of touchscreen
- y-size: vertical resolution of touchscreen

Optional properties:
- contact-threshold: only with "melfas,mms114"
- moving-threshold: only with "melfas,mms114"
- x-invert: invert X axis
- y-invert: invert Y axis

Example:

	i2c@00000000 {
		/* ... */

		touchscreen@48 {
			compatible = "melfas,mms114";
			reg = <0x48>;
			interrupts = <39 0>;
			x-size = <720>;
			y-size = <1280>;
			contact-threshold = <10>;
			moving-threshold = <10>;
			x-invert;
			y-invert;
		};

		/* ... */
	};
```

## Documentation/devicetree/bindings/leds/leds-an30259a.txt
```
* Panasonic AN30259A 3-channel LED driver

The AN30259A is a LED controller capable of driving three LEDs independently. It supports
constant current output and sloping current output modes. The chip is connected over I2C.

Required properties:
	- compatible : must be "panasonic,an30259a"
	- reg -  I2C slave address

Each led is represented as a sub-node of the panasonic,an30259a node.

Optional sub-node properties:
	- label: see Documentation/devicetree/bindings/leds/common.txt
	- linux,default-trigger: see Documentation/devicetree/bindings/leds/common.txt
    - led-sources: 0 if LED is connected to LED1 pin,
      1 if LED is connected to LED2 pin, or 2 if LED is connected to LED3 pin.

Example:
    an30259a@30 {
        compatible = "panasonic,an30259a";
        reg = <0x30>;

        red {
            led-sources = <0>;
            linux,default-trigger = "heartbeat";
            label = "red";
        };

        green {
            led-sources = <1>;
            label = "green";
        };

        blue {
            led-sources = <2>;
            label = "blue";
        };
    };

For more information please see the link below:
https://www.alliedelec.com/m/d/a9d2b3ee87c2d1a535a41dd747b1c247.pdf
```

## Documentation/devicetree/bindings/net/linux,rfkill-gpio.txt
```
Generic GPIO RF kill switch device tree binding

Required properties:
 - compatible: must be "linux,rfkill-gpio".
 - name: user-facing name of the kill switch.
 - type: type of the RF emitter controlled by this kill switch.
         Valid values are:
          "wlan" - 802.11 wireless network.
          "bluetooth" - Bluetooth.
          "ultrawideband" - Ultra wideband.
          "wimax" - WiMAX.
          "wwan" - Wireless WAN.
          "gps" - GPS.
          "fm" - FM radio.
          "nfc" - NFC.

At least one of the following properties must be specified:
 - reset-gpios: GPIO that, when asserted, will enable the RF emitter
 - shutdown-gpios: GPIO that, when asserted, will enable the RF emitter
Both of these GPIOs are controlled simultaneously by the driver.

Optional properties:
 - clocks: Clock that is enabled before unblocking and disabled after blocking.


Example:

rfkill-gpio {
        compatible = "linux,rfkill-gpio";
        name = "BCM4752";
        type = "gps";

        reset-gpios = <&gpx1 1 GPIO_ACTIVE_HIGH>;

        clocks = <&clock CLK_XUSBXTI>;
};
```

## drivers/iio/common/ssp_v2/Kconfig
```kconfig
#
# SSP sensor drivers and commons configuration
#
menu "Samsung SSP Sensorhub"

config IIO_SSP_V2
    tristate
	select IIO_BUFFER
	select IIO_KFIFO_BUF

config IIO_SSP_V2_I2C
    tristate "SSP connected via I2C"
    depends on I2C
    select IIO_SSP_V2
    help
      Say Y to build support for I2C connected SSP.
      If unsure, say N.
endmenu
```
